## main/Kconfig.projbuild
```kconfig
menu "Example Configuration"

    config ESP_WIFI_SSID
        string "WiFi SSID"
        default "myssid"
        help
            SSID (network name) for the example to connect to.

    config ESP_WIFI_PASSWORD
        string "WiFi Password"
        default "mypassword"
        help
            WiFi password (WPA or WPA2) for the example to use.

    choice ESP_WIFI_SAE_MODE
        prompt "WPA3 SAE mode selection"
        default ESP_WPA3_SAE_PWE_BOTH
        help
            Select mode for SAE as Hunt and Peck, H2E or both.
        config ESP_WPA3_SAE_PWE_HUNT_AND_PECK
            bool "HUNT AND PECK"
        config ESP_WPA3_SAE_PWE_HASH_TO_ELEMENT
            bool "H2E"
        config ESP_WPA3_SAE_PWE_BOTH
            bool "BOTH"
    endchoice

    config ESP_WIFI_PW_ID
        string "PASSWORD IDENTIFIER"
        depends on  ESP_WPA3_SAE_PWE_HASH_TO_ELEMENT|| ESP_WPA3_SAE_PWE_BOTH
        default ""
        help
            password identifier for SAE H2E

    config ESP_MAXIMUM_RETRY
        int "Maximum retry"
        default 5
        help
            Set the Maximum retry to avoid station reconnecting to the AP unlimited when the AP is really inexistent.

    choice ESP_WIFI_SCAN_AUTH_MODE_THRESHOLD
        prompt "WiFi Scan auth mode threshold"
        default ESP_WIFI_AUTH_WPA2_PSK
        help
            The weakest authmode to accept in the scan mode.
            This value defaults to ESP_WIFI_AUTH_WPA2_PSK incase password is present and ESP_WIFI_AUTH_OPEN is used.
            Please select ESP_WIFI_AUTH_WEP/ESP_WIFI_AUTH_WPA_PSK incase AP is operating in WEP/WPA mode.

        config ESP_WIFI_AUTH_OPEN
            bool "OPEN"
        config ESP_WIFI_AUTH_WEP
            bool "WEP"
        config ESP_WIFI_AUTH_WPA_PSK
            bool "WPA PSK"
        config ESP_WIFI_AUTH_WPA2_PSK
            bool "WPA2 PSK"
        config ESP_WIFI_AUTH_WPA_WPA2_PSK
            bool "WPA/WPA2 PSK"
        config ESP_WIFI_AUTH_WPA3_PSK
            bool "WPA3 PSK"
        config ESP_WIFI_AUTH_WPA2_WPA3_PSK
            bool "WPA2/WPA3 PSK"
        config ESP_WIFI_AUTH_WAPI_PSK
            bool "WAPI PSK"
    endchoice

    menu "MQTT Configuration"

        config MQTT_BROKER_URL
            string "MQTT Broker URL"
            default "mqtt://mqtt.eclipseprojects.io"
            help
                MQTT Broker 地址，支持以下格式：
                - mqtt://host:port    (TCP, 默认端口 1883)
                - mqtts://host:port   (TLS, 默认端口 8883)
                - ws://host:port/path (WebSocket)
                - wss://host:port/path (WebSocket Secure)

        config MQTT_CLIENT_ID
            string "MQTT Client ID"
            default ""
            help
                MQTT 客户端 ID，用于标识设备。
                留空则自动生成 (ESP32_XXXX 格式，XXXX 为 MAC 地址后 3 字节)。

        config MQTT_USERNAME
            string "MQTT Username"
            default ""
            help
                MQTT 用户名，用于 Broker 认证。
                如果 Broker 不需要认证，留空即可。

        config MQTT_PASSWORD
            string "MQTT Password"
            default ""
            help
                MQTT 密码，用于 Broker 认证。
                如果 Broker 不需要认证，留空即可。

        config ONENET_DEVICE_ID
            string "OneNET Device ID"
            default "2562544490"
            help
                OneNET 平台的设备 ID，用于消息上报时的 id 字段。

    endmenu

endmenu
```
